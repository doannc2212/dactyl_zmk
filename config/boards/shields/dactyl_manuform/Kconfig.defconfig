## config/boards/shields/dactyl_manuform/Kconfig.defconfig
```kconfig
if SHIELD_DACTYL_MANUFORM_DONGLE

config ZMK_KEYBOARD_NAME
	default "Dactyl"

config ZMK_SPLIT_BLE_ROLE_CENTRAL
	default y
	

endif

if SHIELD_DACTYL_MANUFORM_LEFT || SHIELD_DACTYL_MANUFORM_RIGHT || SHIELD_DACTYL_MANUFORM_DONGLE 

config ZMK_SPLIT
	default y

	
endif
```

## config/west.yml
```yaml
manifest:
  remotes:
    - name: zmkfirmware
      url-base: https://github.com/petejohanson
    - name: inorichi
      url-base: https://github.com/inorichi
    - name: zmkfirmware
      url-base: https://github.com/zmkfirmware
  projects:
    - name: zmk
      remote: zmkfirmware
      revision: feat/pointers-move-scroll
      import: app/west.yml
  self:
    path: config
```
